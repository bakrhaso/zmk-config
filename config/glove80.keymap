#define CONFIG_WIRELESS
#define ZMK_BASE_LAYER(name, LT, RT, LM, RM, LB, RB, LH, RH)                                      \
    ZMK_LAYER(                                                                                    \
        name,                                                                                     \
        &kp F1    &kp F2 &kp F3 &kp F4 &kp F5               &kp F6 &kp F7 &kp F8 &kp F9 &kp F10   \
        &kp EQUAL &kp N1 &kp N2 &kp N3 &kp N4 &kp N5 &kp N6 &kp N7 &kp N8 &kp N9 &kp N0 &kp MINUS \
        &kp TAB              LT                                            RT           &kp RA(Z) \
        &kp ESC              LM                                            RM           &kp RA(W) \
        &kp GRAVE            LB                                                                   \
            &caps_word_ht LSHFT 0 &kp LCTRL &mo LOWER &kp LGUI &kp RCTRL &caps_word_ht RSHFT 0   \
                                               RB                                    &kp PG_UP    \
                   &mo MAGIC &kp HOME &kp END                                               \
        &kp LEFT  &kp RIGHT  LH &kp LALT                    &kp RALT     RH    &kp UP &kp DOWN   \
                                                   &kp LBKT &kp RBKT &kp PG_DN)

#include "zmk-helpers/key-labels/glove80.h"
#include "base.keymap"
