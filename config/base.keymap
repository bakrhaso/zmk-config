#include <behaviors.dtsi>
#include <zmk-helpers/helper.h>
#include <dt-bindings/zmk/keys.h>
#include <dt-bindings/zmk/rgb.h>
#ifdef CONFIG_WIRELESS
  #include <dt-bindings/zmk/bt.h>
  #include <dt-bindings/zmk/outputs.h>
#endif

#define DEF 0
#define CURSOR 1
#define SYMBOL 2
#define LOWER 3
#define MOUSE 4
#define MOUSE_SLOW 5
#define MOUSE_FAST 6
#define MOUSE_WARP 7
#define MAGIC 8
#define GAMING 9

#define XXX &none
#define ___ &trans

/* Global defaults */

#define QUICK_TAP_MS 175

&sk {
  release-after-ms = <900>;
  quick-release;
};

&sl { // Allow sticky mods to chord across sticky layers.
  ignore-modifiers;
};

&lt {
  flavor = "balanced";
  tapping-term-ms = <200>;
  quick-tap-ms = <QUICK_TAP_MS>;
};

/* Homerow mods — urob's timeless HRM setup */

#define KEYS_L LT0 LT1 LT2 LT3 LT4 LM0 LM1 LM2 LM3 LM4 LB0 LB1 LB2 LB3 LB4
#define KEYS_R RT0 RT1 RT2 RT3 RT4 RM0 RM1 RM2 RM3 RM4 RB0 RB1 RB2 RB3 RB4
#ifndef LH2
  #define THUMBS LH1 LH0 RH0 RH1         // Thumbs on 34 keys.
#else
  #define THUMBS LH2 LH1 LH0 RH0 RH1 RH2 // Thumbs on 36+ keys.
#endif

#define MAKE_HRM(NAME, HOLD, TAP, TRIGGER_POS)                                 \
  ZMK_HOLD_TAP(NAME, bindings = <HOLD>, <TAP>; flavor = "balanced";            \
               tapping-term-ms = <280>; quick-tap-ms = <QUICK_TAP_MS>;         \
               require-prior-idle-ms = <150>; hold-trigger-on-release;         \
               hold-trigger-key-positions = <TRIGGER_POS>;)

MAKE_HRM(hml, &kp, &kp, KEYS_R THUMBS) // Left-hand HRMs.
MAKE_HRM(hmr, &kp, &kp, KEYS_L THUMBS) // Right-hand HRMs.

// Hack: Make HRM combos tap-only (cf, ZMK issue #544).
#define ZMK_COMBO_8(NAME, TAP, POS, LAYERS, COMBO_MS, IDLE_MS, HOLD, SIDE)     \
  MAKE_HRM(hm_combo_##NAME, &kp, TAP, SIDE THUMBS)                             \
  ZMK_COMBO_6(NAME, &hm_combo_##NAME HOLD 0, POS, LAYERS, COMBO_MS, IDLE_MS)

/* Combos and mouse */

#include "combos.dtsi" // Must be sourced after HRM-combo hack.
// #include "leader.dtsi"  // Urob leader key — uncomment to explore later.
#include "mouse.dtsi"

/* Custom behaviors */

// CAPSWord: hold = shift, tap = caps_word.
ZMK_HOLD_TAP(caps_word_ht, bindings = <&kp>, <&caps_word>;
             tapping-term-ms = <200>;)

// Thumb hold-taps (from TailorKey).
ZMK_HOLD_TAP(thumb_ht, bindings = <&mo>, <&kp>; flavor = "balanced";
             tapping-term-ms = <200>; quick-tap-ms = <300>;)
ZMK_HOLD_TAP(space_ht, bindings = <&mo>, <&kp>; flavor = "balanced";
             tapping-term-ms = <200>; quick-tap-ms = <150>;)

// Symbol layer: double-dot macro.
ZMK_MACRO(symb_dotdot, bindings = <&kp DOT &kp DOT>; wait-ms = <0>; tap-ms = <0>;)

// Cursor helper macros.
ZMK_MACRO(cur_extend_line, bindings = <&kp LS(END)>; wait-ms = <1>; tap-ms = <1>;)
ZMK_MACRO(cur_extend_word, bindings = <&kp LC(LS(RIGHT))>; wait-ms = <1>; tap-ms = <1>;)
ZMK_MACRO(cur_select_line, bindings = <&kp HOME &kp LS(END)>; wait-ms = <1>; tap-ms = <1>;)
ZMK_MACRO(cur_select_none, bindings = <&kp DOWN &kp UP &kp RIGHT &kp LEFT>; wait-ms = <1>; tap-ms = <1>;)
ZMK_MACRO(cur_select_word, bindings = <&kp LC(LEFT) &kp LC(LS(RIGHT))>; wait-ms = <1>; tap-ms = <1>;)

// Magic key: just a layer momentary.
// (RGB_STATUS is Glove80/MoErgo-specific, not available in upstream ZMK.)

/* 80 transparent keys for mouse speed sub-layers */
#define LAYER_TRANSPARENT80                                                     \
    ___ ___ ___ ___ ___                             ___ ___ ___ ___ ___         \
    ___ ___ ___ ___ ___ ___                   ___ ___ ___ ___ ___ ___           \
    ___ ___ ___ ___ ___ ___                   ___ ___ ___ ___ ___ ___           \
    ___ ___ ___ ___ ___ ___                   ___ ___ ___ ___ ___ ___           \
    ___ ___ ___ ___ ___ ___ ___ ___ ___ ___ ___ ___ ___ ___ ___ ___ ___ ___     \
    ___ ___ ___ ___ ___     ___ ___ ___ ___ ___ ___     ___ ___ ___ ___ ___

/* Keymap */

#ifndef ZMK_BASE_LAYER
  #define ZMK_BASE_LAYER(name, LT, RT, LM, RM, LB, RB, LH, RH)                 \
      ZMK_LAYER(name, LT RT LM RM LB RB LH RH)
#endif

ZMK_BASE_LAYER(Base,
//╭─────────────┬─────────────┬─────────────┬─────────────┬─────────────╮ ╭─────────────┬─────────────┬─────────────┬─────────────┬─────────────╮
    &kp Q         &kp W         &kp F         &kp P         &kp B       ,   &kp J         &kp L         &kp U         &kp Y         &kp RA(L)   ,
//├─────────────┼─────────────┼─────────────┼─────────────┼─────────────┤ ├─────────────┼─────────────┼─────────────┼─────────────┼─────────────┤
    &hml LGUI A   &hml LALT R   &hml LCTRL S  &hml LSHFT T  &kp G       ,   &kp M         &hmr RSHFT N  &hmr RCTRL E  &hmr LALT I   &hmr RGUI O ,
//├─────────────┼─────────────┼─────────────┼─────────────┼─────────────┤ ├─────────────┼─────────────┼─────────────┼─────────────┼─────────────┤
    &kp Z         &kp X         &kp C         &kp D         &kp V       ,   &kp K         &kp H         &kp COMMA     &kp DOT       &kp FSLH    ,
//╰─────────────┼─────────────┴─────────────┼─────────────┼─────────────┤ ├─────────────┼─────────────┼─────────────┴───────────────────────────╯
                              &thumb_ht CURSOR BSPC &kp DEL              ,   &thumb_ht MOUSE RET &space_ht SYMBOL SPACE
//                                          ╰─────────────┴─────────────╯ ╰─────────────┴─────────────╯
)

ZMK_LAYER(Cursor,
//  ╭── Row 0: F-key row (pos 0-9) ──╮
    XXX       XXX       XXX       XXX       XXX                                     XXX       XXX       XXX       XXX       XXX
//  ╭── Row 1: number row (pos 10-21) ──╮
    XXX       &kp ESC   &kp INS   &kp LS(TAB) &kp DEL XXX                    XXX   XXX       XXX       XXX       XXX       XXX
//  ╭── Row 2: top alpha (pos 22-33) ──╮
    XXX       &kp RET   &kp SPACE &kp TAB   &kp BSPC  &kp LC(X)             &kp LS(DEL) &kp LS(TAB) &kp LC(Z) &kp LC(Y) &kp TAB   XXX
//  ╭── Row 3: home row (pos 34-45) ──╮
    &sk LSHFT &kp LGUI  &kp LALT  &kp LCTRL &kp LSHFT  &kp LC(C)            &kp LC(INS) &kp LEFT  &kp UP    &kp DOWN  &kp RIGHT &sk RSHFT
//  ╭── Row 4: bottom + inner thumbs (pos 46-63) ──╮
    &kp LC(L) &kp LSHFT XXX       XXX       &kp LC(F)  &kp LC(V)  XXX XXX &kp PSCRN XXX XXX XXX  &kp LS(INS) &kp HOME &kp PG_UP &kp PG_DN &kp END &kp LC(L)
//  ╭── Row 5: outer + main thumbs (pos 64-79) ──╮
    &kp LC(K) &kp LC(Z) &kp LC(Y) &kp LC(LS(G)) &kp LC(G)  XXX XXX &kp LG(D)  XXX XXX XXX  &kp LC(F) &kp LC(LS(G)) &kp LC(G) &kp LC(H) &kp LC(K)
)

ZMK_LAYER(Symbol,
//  ╭── Row 0 ──╮
    XXX       XXX       XXX       XXX       XXX                                     XXX       XXX       XXX       XXX       XXX
//  ╭── Row 1 ──╮
    &kp GRAVE &kp RBKT  &kp LS(N9) &kp LS(N0) &kp COMMA &kp DOT               XXX XXX       XXX       XXX       XXX       XXX
//  ╭── Row 2 ──╮
    &kp LBKT  &kp LS(N1) &kp LS(LBKT) &kp LS(RBKT) &kp SEMI &kp LS(FSLH)     &kp GRAVE &sk RSHFT &sk RCTRL &sk RALT  &sk RGUI  XXX
//  ╭── Row 3 ──╮
    &kp LS(N3) &kp LS(N6) &kp EQUAL &kp LS(MINUS) &kp LS(N4) &kp LS(N8)      &kp LS(SQT) &kp BSPC &kp TAB  &kp SPACE &kp RET  XXX
//  ╭── Row 4 ──╮
    &kp LS(GRAVE) &kp LS(COMMA) &kp LS(BSLH) &kp MINUS &kp LS(DOT) &kp FSLH  &kp BSLH &kp DOT &kp LS(N8) XXX XXX XXX  &kp SQT &kp DEL &kp LS(TAB) &kp INS &kp ESC XXX
//  ╭── Row 5 ──╮
    &symb_dotdot &kp LS(N7) &kp SQT &kp LS(SQT) &kp LS(EQUAL)  &kp LS(N5) &kp LS(SEMI) &kp LS(N2)  XXX XXX XXX  XXX XXX XXX XXX XXX
)

ZMK_LAYER(Lower,
//  ╭── Row 0 ──╮
    &kp C_BRI_DN &kp C_BRI_UP &kp C_PREV &kp C_NEXT &kp C_PP                      &kp C_MUTE &kp C_VOL_DN &kp C_VOL_UP XXX &kp PAUSE_BREAK
//  ╭── Row 1 ──╮
    ___       XXX       XXX       XXX       XXX       &kp HOME                &kp LS(N9) &kp KP_NUM &kp EQUAL &kp KP_SLASH &kp KP_MULTIPLY &kp PSCRN
//  ╭── Row 2 ──╮
    ___       XXX       XXX       &kp UP    XXX       &kp END                 &kp LS(N0) &kp KP_N7 &kp KP_N8 &kp KP_N9 &kp KP_MINUS &kp SLCK
//  ╭── Row 3 ──╮
    ___       XXX       &kp LEFT  &kp DOWN  &kp RIGHT &kp PG_UP              &kp LS(N5) &kp KP_N4 &kp KP_N5 &kp KP_N6 &kp KP_PLUS XXX
//  ╭── Row 4 ──╮
    ___       &kp K_APP XXX       &kp F11   &kp F12   &kp PG_DN  ___ ___ &to DEF ___ ___ ___  &kp COMMA &kp KP_N1 &kp KP_N2 &kp KP_N3 &kp KP_ENTER ___
//  ╭── Row 5 ──╮
    &mo MAGIC &kp CAPS &kp INS &kp F11 &kp F12  ___ ___ ___  ___ ___ ___  &kp KP_N0 &kp KP_N0 &kp KP_DOT &kp KP_ENTER ___
)

ZMK_LAYER(Mouse,
//  ╭── Row 0 ──╮
    XXX       XXX       XXX       XXX       XXX                                     XXX       XXX       XXX       XXX       XXX
//  ╭── Row 1 ──╮
    XXX       XXX       XXX       XXX       XXX       XXX                     XXX   XXX       XXX       XXX       XXX       XXX
//  ╭── Row 2 ──╮
    XXX       XXX       &msc SCRL_LEFT &mmv MOVE_UP &msc SCRL_RIGHT XXX      XXX   &sk RSHFT &sk RCTRL &sk RALT  &sk RGUI  XXX
//  ╭── Row 3 ──╮
    XXX       &msc SCRL_UP &mmv MOVE_LEFT &mmv MOVE_DOWN &mmv MOVE_RIGHT &msc SCRL_UP  &msc SCRL_UP &mo MOUSE_FAST &mo MOUSE_WARP &mo MOUSE_SLOW &mkp LCLK &mkp MB4
//  ╭── Row 4 ──╮
    XXX       &msc SCRL_DOWN &mo MOUSE_SLOW &mo MOUSE_WARP &mo MOUSE_FAST &msc SCRL_DOWN  &mkp MCLK &kp K_APP &mkp MB5 &kp LC(X) &kp LC(C) &kp LC(V)  &msc SCRL_DOWN &msc SCRL_LEFT &mmv MOVE_UP &msc SCRL_RIGHT &mkp RCLK &mkp MB5
//  ╭── Row 5 ──╮
    XXX       XXX       XXX       XXX       XXX       &mkp LCLK &mkp RCLK &mkp MB4  XXX XXX XXX  &mmv MOVE_LEFT &mmv MOVE_DOWN &mmv MOVE_RIGHT &mkp MCLK &kp K_APP
)

ZMK_LAYER(MouseSlow, LAYER_TRANSPARENT80)
ZMK_LAYER(MouseFast, LAYER_TRANSPARENT80)
ZMK_LAYER(MouseWarp, LAYER_TRANSPARENT80)

ZMK_LAYER(Magic,
//  ╭── Row 0 ──╮
    XXX       XXX       XXX       XXX       XXX                                     XXX       XXX       XXX       &bt BT_CLR &bt BT_CLR_ALL
//  ╭── Row 1 ──╮
    &to DEF   XXX       XXX       XXX       XXX       XXX                     XXX   XXX       XXX       XXX       XXX       XXX
//  ╭── Row 2 ──╮
    XXX       &rgb_ug RGB_SPI &rgb_ug RGB_SAI &rgb_ug RGB_HUI &rgb_ug RGB_BRI &rgb_ug RGB_TOG  XXX XXX XXX XXX XXX XXX
//  ╭── Row 3 ──╮
    &bootloader &rgb_ug RGB_SPD &rgb_ug RGB_SAD &rgb_ug RGB_HUD &rgb_ug RGB_BRD &rgb_ug RGB_EFF  XXX XXX XXX XXX XXX &bootloader
//  ╭── Row 4 ──╮
    &sys_reset XXX XXX XXX XXX XXX  &bt BT_SEL 2 &bt BT_SEL 3 XXX XXX XXX XXX  XXX XXX XXX XXX XXX &sys_reset
//  ╭── Row 5 ──╮
    XXX       XXX       XXX       XXX       XXX       &bt BT_SEL 0 &bt BT_SEL 1 &out OUT_USB  XXX XXX XXX  XXX XXX XXX XXX XXX
)

ZMK_LAYER(Gaming,
//  ╭── Row 0 ──╮
    &kp ESC   &kp P     &kp O     &kp N     &kp BSPC                               &kp F1    &kp F2    &kp F3    &kp F4    &kp F5
//  ╭── Row 1 ──╮
    &kp M     &kp N6    &kp N7    &kp N8    &kp N9    &kp N0                  &kp F6 &kp F7   &kp F8    &kp F9    &kp F10   &kp F11
//  ╭── Row 2 ──╮
    &kp I     &kp N1    &kp N2    &kp N3    &kp N4    &kp N5                  &kp Y  &kp U    &kp I     &kp O     &kp P     &kp F12
//  ╭── Row 3 ──╮
    &kp T     &kp TAB   &kp Q     &kp W     &kp E     &kp R                   &kp H  &kp J    &kp K     &kp L     &kp SEMI  &kp SQT
//  ╭── Row 4 ──╮
    &kp G     &kp LSHFT &kp A     &kp S     &kp D     &kp F     &kp LSHFT &kp LALT &kp V &kp ESC &kp UP &kp RET  &kp N &kp M &kp COMMA &kp DOT &kp FSLH &kp MINUS
//  ╭── Row 5 ──╮
    &kp B     &kp LCTRL &kp Z     &kp X     &kp C     &kp SPACE &kp LCTRL &kp RET  &kp LEFT &kp DOWN &kp RIGHT  &kp GRAVE &kp LBKT &kp RBKT &kp BSLH &kp EQUAL
)

/* vim: set ft=c tw=146: */

/* ==========================================================================
 * UROB'S ORIGINAL FEATURES — preserved for reference and future exploration.
 *
 * To re-enable a feature:
 * 1. Uncomment the behavior/macro definition below
 * 2. Add it to a key binding in the appropriate layer
 * 3. Re-enable any required modules in west.yml
 *
 * Features worth exploring:
 *
 * - Magic shift (requires zmk-adaptive-key module):
 *   Tap = repeat after alpha, else sticky-shift.
 *   Shift+tap = caps-word. Hold = shift.
 *   Very efficient shift replacement.
 *
 *   #define MAGIC_SHIFT &magic_shift LSHFT 0
 *   ZMK_HOLD_TAP(magic_shift, bindings = <&kp>, <&magic_shift_tap>;
 *                flavor = "balanced"; tapping-term-ms = <200>;
 *                quick-tap-ms = <QUICK_TAP_MS>;)
 *   ZMK_MOD_MORPH(magic_shift_tap, bindings = <&shift_repeat>, <&caps_word>;
 *                 mods = <(MOD_LSFT)>;)
 *   ZMK_ADAPTIVE_KEY(
 *       shift_repeat, bindings = <&sk LSHFT>;
 *       repeat {
 *         trigger-keys = <A B C D E F G H I J K L M N O P Q R S T U V W X Y Z>;
 *         bindings = <&key_repeat>;
 *         max-prior-idle-ms = <1200>;
 *         strict-modifiers;
 *       };)
 *
 * - Smart num (requires zmk-auto-layer module):
 *   Tap = num-word (auto-deactivates after non-number).
 *   Double-tap = sticky num layer. Hold = num layer.
 *
 *   #define SMART_NUM &smart_num NUM 0
 *   ZMK_HOLD_TAP(smart_num, bindings = <&mo>, <&num_dance>; flavor = "balanced";
 *                tapping-term-ms = <200>; quick-tap-ms = <QUICK_TAP_MS>;)
 *   ZMK_TAP_DANCE(num_dance, bindings = <&num_word NUM>, <&sl NUM>;
 *                 tapping-term-ms = <200>;)
 *
 * - Swapper / Alt+Tab (requires zmk-tri-state module):
 *   ZMK_TRI_STATE(swapper, bindings = <&kt LALT>, <&kp TAB>, <&kt LALT>;
 *                 ignored-key-positions = <LT2 RT2 RM1 RM2 RM3>;)
 *
 * - Mod-morphs (no extra modules needed):
 *   Comma → semicolon on shift, dot → colon on shift, ? → ! on shift.
 *   Removes need for these symbols on a separate layer.
 *
 *   #define SIMPLE_MORPH(NAME, MOD, BINDING1, BINDING2)
 *     ZMK_MOD_MORPH(NAME, mods = <(MOD_L##MOD | MOD_R##MOD)>;
 *                   bindings = <BINDING1>, <BINDING2>;)
 *   SIMPLE_MORPH(comma_morph, SFT, &kp COMMA, &comma_inner_morph)
 *   SIMPLE_MORPH(comma_inner_morph, CTL, &kp SEMICOLON, &kp LESS_THAN)
 *   SIMPLE_MORPH(dot_morph, SFT, &kp DOT, &dot_inner_morph)
 *   SIMPLE_MORPH(dot_inner_morph, CTL, &kp COLON, &kp GREATER_THAN)
 *   SIMPLE_MORPH(qexcl, SFT, &kp QMARK, &kp EXCL)
 *
 * - Space/Nav with sentence-ending:
 *   Shift+space = ". " + sticky shift.
 *
 *   ZMK_HOLD_TAP(lt_spc, bindings = <&mo>, <&spc_morph>; flavor = "balanced";
 *                tapping-term-ms = <200>; quick-tap-ms = <QUICK_TAP_MS>;)
 *   SIMPLE_MORPH(spc_morph, SFT, &kp SPACE, &dot_spc)
 *   ZMK_MACRO(dot_spc, bindings = <&kp DOT &kp SPACE &sk LSHFT>;
 *             wait-ms = <0>; tap-ms = <5>;)
 *
 * - Nav cluster (no extra modules needed):
 *   Tap = arrow. Long-tap = jump (home/end/start-of-doc/end-of-doc).
 *
 *   #define NAV_LEFT  &mt_home 0   LEFT
 *   #define NAV_RIGHT &mt_end 0    RIGHT
 *   #define NAV_UP    &mt LC(HOME) UP
 *   #define NAV_DOWN  &mt LC(END)  DOWN
 *   #define NAV_BSPC  &mt LC(BSPC) BSPC
 *   #define NAV_DEL   &mt LC(DEL)  DEL
 *
 * - Leader key (requires zmk-leader-key + zmk-unicode modules):
 *   Type sequences to produce unicode chars (umlauts, greek letters).
 *   See leader.dtsi for the full configuration.
 *
 * - Vertical/horizontal combos (see combos.dtsi reference section):
 *   Symbols produced by pressing two adjacent keys. Eliminates need
 *   for a symbol layer entirely.
 *
 * See urob's README and git history for full documentation.
 * ========================================================================== */
